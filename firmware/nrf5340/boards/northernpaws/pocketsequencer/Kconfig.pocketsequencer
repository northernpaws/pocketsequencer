## firmware/nrf5340/boards/northernpaws/pocketsequencer/Kconfig.pocketsequencer
```kconfig
config BOARD_POCKETSEQUENCER
	select SOC_NRF5340_CPUAPP_QKAA if BOARD_POCKETSEQUENCER_NRF5340_CPUAPP
	select SOC_NRF5340_CPUAPP_QKAA if BOARD_POCKETSEQUENCER_NRF5340_CPUAPP_NS
	select SOC_NRF5340_CPUNET_QKAA if BOARD_POCKETSEQUENCER_NRF5340_CPUNET
```

## firmware/wireless/boards/northernpaws/pocketsequencer/board.yml
```yaml
board:
  name: pocketsequencer
  vendor: northernpaws
  socs:
  - name: nrf5340
    variants:
    - name: ns
      cpucluster: cpuapp
```
